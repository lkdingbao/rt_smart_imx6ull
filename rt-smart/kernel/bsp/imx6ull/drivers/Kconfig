## rt-smart/kernel/bsp/imx6ull/drivers/Kconfig
```kconfig
source "$BSP_DIR/drivers/driver/Kconfig"
source "$BSP_DIR/drivers/device/Kconfig"
```

## rt-smart/kernel/bsp/imx6ull/drivers/device/Kconfig
```kconfig
menu "Platform Device Configuration"

menuconfig RT_USING_GT9147
    bool "Enable GT9147 device"
    select RT_USING_I2C
    default y

    if RT_USING_GT9147
        config BSP_TOUCH_POINT_NUM
            int "Number of touch point"
            default 5
    endif

menuconfig RT_USING_PCF8574
    bool "Enable PCF8574 device"
    select RT_USING_I2C
    default y

    if RT_USING_PCF8574
        config BSP_PCF_COL_NUM
            int "Number of column per row"
            default 16
        config BSP_PCF_ROW_NUM
            int "Number of row per column"
            default 2
    endif

menuconfig RT_USING_DS1307
    bool "Enable DS1307 device"
    select RT_USING_I2C
    default y

menuconfig RT_USING_MPU6050
    bool "Enable MPU6050 device"
    select RT_USING_I2C
    default y

menuconfig RT_USING_EEPROM
    bool "Enable EEPROM device"
    select RT_USING_I2C
    default y
    
    if RT_USING_EEPROM
        config BSP_EEPROM_DOUBLE_BAK_EN
            bool "Enable double backup"
            default n
        config BSP_EEPROM_SIZE
            int "Total size of eeprom"
            default 4096
        config BSP_EEPROM_PAGE_SIZE
            int "Page size of eeprom"
            default 32
    endif

menuconfig RT_USING_ENET
    bool "Enable Ethernet device"
    default y

    if RT_USING_ENET
        config RT_USING_LAN8720
            bool "Enable LAN8720"
            default y
    endif

menuconfig RT_USING_CAMERA
    bool "Enable Camera device"
    default y

    if RT_USING_CAMERA
        config RT_USING_OV2640
            bool "Enable OV2640"
            default y
    endif

endmenu
```

## rt-smart/kernel/bsp/imx6ull/drivers/driver/Kconfig
```kconfig
menu "Platform Driver Configuration"

menu "Select UART Driver"
    if RT_USING_SERIAL
        config BSP_USING_UART1
            bool "Enable UART1"
            default y
        config BSP_USING_UART2
            bool "Enable UART2"
            default n
        config BSP_USING_UART3
            bool "Enable UART3"
            default n
        config BSP_USING_UART4
            bool "Enable UART4"
            default n
        config BSP_USING_UART5
            bool "Enable UART5"
            default n
        config BSP_USING_UART6
            bool "Enable UART6"
            default n
        config BSP_USING_UART7
            bool "Enable UART7"
            default n
        config BSP_USING_UART8
            bool "Enable UART8"
            default n
    endif
endmenu

menu "Select SPI Driver"
    if RT_USING_SPI
        config BSP_USING_SPI1
            bool "Enable SPI1"
            default n
        config BSP_USING_SPI2
            bool "Enable SPI2"
            default n
        config BSP_USING_SPI3
            bool "Enable SPI3"
            default y
        config BSP_USING_SPI4
            bool "Enable SPI4"
            default n
    endif
endmenu

menu "Select I2C Driver"
    if RT_USING_I2C
        config BSP_USING_I2C1
            bool "Enable I2C1"
            default n
        config BSP_USING_I2C2
            bool "Enable I2C2"
            default y
        config BSP_USING_I2C3
            bool "Enable I2C3"
            default n
        config BSP_USING_I2C4
            bool "Enable I2C4"
            default n
    endif
endmenu

menu "Select LCD Driver"
config RT_USING_RGBLCD
    bool "Enable RGBLCD"
    default y

    if RT_USING_RGBLCD
        config BSP_LCD_WIDTH
            int "Width of LCD panel"
            default 800

        config BSP_LCD_HEIGHT
            int "Height of LCD panel"
            default 480

        config BSP_LCD_CONSOLE_DEBUG
            bool "Use LCD as console device"
            default n
            
            if BSP_LCD_CONSOLE_DEBUG
                config BSP_LCD_CONSOLE_PARSER
                    bool "Enable LCD console parser function"
                    default n
            endif
    endif
endmenu

menu "Select SD Card Driver"
    if RT_USING_SDIO
        config BSP_USING_SDHC
            bool "Enable SDHC"
            default y
    endif
endmenu

endmenu
```

## rt-smart/kernel/bsp/imx6ull/libs/Kconfig
```kconfig
menu "Third-party Libraries Configuration"

menuconfig RT_USING_LVGL
    bool "Enable LittlevGL"
    default n

    if RT_USING_LVGL
        config BSP_USING_LVGL_GPU
            bool "Enable littlevGL GPU"
            default n
        config BSP_USING_LVGL_EXAMPLE
            bool "Using littlevGL examples"
    endif

menuconfig RT_USING_GRAPHIC3D
    bool "Enable Graphic3d"
    default n

    if RT_USING_GRAPHIC3D
        config BSP_GRAPHIC3D_BUFFER_WIDTH
            int "Set Graphic buffer width"
            default 800
        config BSP_GRAPHIC3D_BUFFER_HEIGHT
            int "Set Graphic buffer height"
            default 480
        config BSP_GRAPHIC3D_OBJECT_MODEL
            int "Set Graphic object model(0:none/1:rock/2:cow)"
            default 2
    endif

endmenu
```

## rt-smart/kernel/bsp/imx6ull_smart/Kconfig
```kconfig
mainmenu "RT-Thread Project Configuration"

config BSP_DIR
    string
    option env="BSP_ROOT"
    default "."

config RTT_DIR
    string
    option env="RTT_ROOT"
    default "../.."

config PKGS_DIR
    string
    option env="PKGS_ROOT"
    default "packages"

source "$RTT_DIR/Kconfig"
source "$PKGS_DIR/Kconfig"

config RT_MAIN_THREAD_STACK_SIZE
    int 
    default 2048

config RT_MAIN_THREAD_PRIORITY
    int 
    default 10

menu "Platform Configuration"
config SOC_CPU_MX6
    bool "Sel NXP i.MX6 series"
    default y

    select ARCH_ARM
    select ARCH_ARM_MMU
    select ARCH_ARM_CORTEX_A
    select ARCH_ARM_CORTEX_A7
    select RT_USING_USERSPACE
    select RT_USING_COMPONENTS_INIT
    select RT_USING_USER_MAIN
    select RT_USING_CACHE

    if SOC_CPU_MX6
        config CPU_MCIMX6Y2CVM05
            bool "Select i.MX6ULL"
            default y
        config FSL_SDK_ENABLE_DRIVER_CACHE_CONTROL
            depends on RT_USING_CACHE
            int "Enable DCache"
            default 1
        config FSL_SDK_DISABLE_DRIVER_CLOCK_CONTROL
            int "Disable Clock control in fsl files"
            default 1
    endif
endmenu

source "$BSP_DIR/drivers/Kconfig"
source "$BSP_DIR/libs/Kconfig"

menu "Program Self Test Code"
config RT_FUNC_SELF_TEST
    bool
    default y

    if RT_FUNC_SELF_TEST
        config RT_FUNC_SELF_TEST_I2C_DEV
            bool "Enable I2C device test code"
            default n
        config RT_FUNC_SELF_TEST_SPI_DEV
            bool "Enable SPI device test code"
            default n
        config RT_FUNC_SELF_TEST_PIN_DEV
            bool "Enable PIN device test code"
            default n
        config RT_FUNC_SELF_TEST_LVGL_DEV
            bool "Enable LittlevGL test code"
            default n
    endif
endmenu
```
